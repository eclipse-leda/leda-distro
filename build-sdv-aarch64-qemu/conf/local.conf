## build-sdv-aarch64-qemu/conf/local.conf
```bitbake
# /********************************************************************************
# * Copyright (c) 2022 Contributors to the Eclipse Foundation
# *
# * See the NOTICE file(s) distributed with this work for additional
# * information regarding copyright ownership.
# *
# * This program and the accompanying materials are made available under the
# * terms of the Apache License 2.0 which is available at
# * https://www.apache.org/licenses/LICENSE-2.0
# *
# * SPDX-License-Identifier: Apache-2.0
# ********************************************************************************/

DISTRO = "leda"
MACHINE ??= "qemuarm64"
DL_DIR ?= "${TOPDIR}/../downloads"
PACKAGE_CLASSES ?= "package_deb"
EXTRA_IMAGE_FEATURES ?= "debug-tweaks"
PATCHRESOLVE = "noop"

BB_DISKMON_DIRS ??= "\
    STOPTASKS,${TMPDIR},1G,100K \
    STOPTASKS,${DL_DIR},1G,100K \
    STOPTASKS,${SSTATE_DIR},1G,100K \
    STOPTASKS,/tmp,100M,100K \
    ABORT,${TMPDIR},100M,1K \
    ABORT,${DL_DIR},100M,1K \
    ABORT,${SSTATE_DIR},100M,1K \
    ABORT,/tmp,10M,1K"

CONF_VERSION = "2"

# Save disk space during build
INHERIT += "rm_work"

# Keep the following files
RM_WORK_EXCLUDE += " sdv-image-full"
RM_WORK_EXCLUDE += " sdv-image-minimal"
RM_WORK_EXCLUDE += " sdv-image-rescue"
RM_WORK_EXCLUDE += " sdv-image-all"
RM_WORK_EXCLUDE += " sdv-rauc-bundle"
```

## build-sdv-aarch64-rpi4/conf/bblayers.conf
```bitbake
# /********************************************************************************
# * Copyright (c) 2022 Contributors to the Eclipse Foundation
# *
# * See the NOTICE file(s) distributed with this work for additional
# * information regarding copyright ownership.
# *
# * This program and the accompanying materials are made available under the
# * terms of the Apache License 2.0 which is available at
# * https://www.apache.org/licenses/LICENSE-2.0
# *
# * SPDX-License-Identifier: Apache-2.0
# ********************************************************************************/

# POKY_BBLAYERS_CONF_VERSION is increased each time build/conf/bblayers.conf
# changes incompatibly
POKY_BBLAYERS_CONF_VERSION = "2"

BBPATH = "${TOPDIR}"
BBFILES ?= ""

YOCTOROOT = "${@os.path.abspath(os.path.join("${TOPDIR}", os.pardir))}"

BBLAYERS ?= " \
  ${YOCTOROOT}/poky/meta \
  ${YOCTOROOT}/poky/meta-poky \
  ${YOCTOROOT}/poky/meta-yocto-bsp \
  ${YOCTOROOT}/meta-leda/meta-sdv-bsp \
  ${YOCTOROOT}/meta-leda/meta-sdv-distro \
  ${YOCTOROOT}/meta-leda/meta-sdv-components \
  ${YOCTOROOT}/meta-rauc \
  ${YOCTOROOT}/meta-openembedded/meta-filesystems \
  ${YOCTOROOT}/meta-openembedded/meta-networking \
  ${YOCTOROOT}/meta-openembedded/meta-oe \
  ${YOCTOROOT}/meta-openembedded/meta-python \
  ${YOCTOROOT}/meta-openembedded/meta-perl \
  ${YOCTOROOT}/meta-virtualization \
  ${YOCTOROOT}/meta-security \
  ${YOCTOROOT}/meta-raspberrypi \
  ${YOCTOROOT}/meta-rauc-community/meta-rauc-raspberrypi \
  ${YOCTOROOT}/patch \
   ${YOCTOROOT}/patch-rpi4 \
  "
```

## build-sdv-arm-qemu/conf/local.conf
```bitbake
# /********************************************************************************
# * Copyright (c) 2022 Contributors to the Eclipse Foundation
# *
# * See the NOTICE file(s) distributed with this work for additional
# * information regarding copyright ownership.
# *
# * This program and the accompanying materials are made available under the
# * terms of the Apache License 2.0 which is available at
# * https://www.apache.org/licenses/LICENSE-2.0
# *
# * SPDX-License-Identifier: Apache-2.0
# ********************************************************************************/

DISTRO = "leda"
MACHINE ??= "qemuarm"
DL_DIR ?= "${TOPDIR}/../downloads"
PACKAGE_CLASSES ?= "package_deb"
EXTRA_IMAGE_FEATURES ?= "debug-tweaks"
PATCHRESOLVE = "noop"

BB_DISKMON_DIRS ??= "\
    STOPTASKS,${TMPDIR},1G,100K \
    STOPTASKS,${DL_DIR},1G,100K \
    STOPTASKS,${SSTATE_DIR},1G,100K \
    STOPTASKS,/tmp,100M,100K \
    ABORT,${TMPDIR},100M,1K \
    ABORT,${DL_DIR},100M,1K \
    ABORT,${SSTATE_DIR},100M,1K \
    ABORT,/tmp,10M,1K"

CONF_VERSION = "2"

# Additional 500MB of disk space
#IMAGE_ROOTFS_EXTRA_SPACE = "512000"

#IMAGE_FSTYPES = "wic.qcow2"
```

## build-sdv-x86_64/conf/bblayers.conf
```bitbake
# /********************************************************************************
# * Copyright (c) 2022 Contributors to the Eclipse Foundation
# *
# * See the NOTICE file(s) distributed with this work for additional
# * information regarding copyright ownership.
# *
# * This program and the accompanying materials are made available under the
# * terms of the Apache License 2.0 which is available at
# * https://www.apache.org/licenses/LICENSE-2.0
# *
# * SPDX-License-Identifier: Apache-2.0
# ********************************************************************************/

# POKY_BBLAYERS_CONF_VERSION is increased each time build/conf/bblayers.conf
# changes incompatibly
POKY_BBLAYERS_CONF_VERSION = "2"

BBPATH = "${TOPDIR}"
BBFILES ?= ""

YOCTOROOT = "${@os.path.abspath(os.path.join("${TOPDIR}", os.pardir))}"

BBLAYERS ?= " \
  ${YOCTOROOT}/poky/meta \
  ${YOCTOROOT}/poky/meta-poky \
  ${YOCTOROOT}/poky/meta-yocto-bsp \
  ${YOCTOROOT}/meta-leda \
  ${YOCTOROOT}/meta-rauc \
  ${YOCTOROOT}/meta-openembedded/meta-filesystems \
  ${YOCTOROOT}/meta-openembedded/meta-networking \
  ${YOCTOROOT}/meta-openembedded/meta-oe \
  ${YOCTOROOT}/meta-openembedded/meta-python \
  ${YOCTOROOT}/meta-openembedded/meta-perl \
  ${YOCTOROOT}/meta-virtualization \
  ${YOCTOROOT}/meta-security \
  ${YOCTOROOT}/meta-rauc-community/meta-rauc-qemux86 \
  ${YOCTOROOT}/patch \
  "
```

## build-sdv-x86_64/conf/local.conf
```bitbake
# /********************************************************************************
# * Copyright (c) 2022 Contributors to the Eclipse Foundation
# *
# * See the NOTICE file(s) distributed with this work for additional
# * information regarding copyright ownership.
# *
# * This program and the accompanying materials are made available under the
# * terms of the Apache License 2.0 which is available at
# * https://www.apache.org/licenses/LICENSE-2.0
# *
# * SPDX-License-Identifier: Apache-2.0
# ********************************************************************************/

DISTRO = "leda"
MACHINE ??= "qemux86-64"
DL_DIR ?= "${TOPDIR}/../downloads"
PACKAGE_CLASSES ?= "package_deb"
EXTRA_IMAGE_FEATURES ?= "debug-tweaks"
PATCHRESOLVE = "noop"

BB_DISKMON_DIRS ??= "\
    STOPTASKS,${TMPDIR},1G,100K \
    STOPTASKS,${DL_DIR},1G,100K \
    STOPTASKS,${SSTATE_DIR},1G,100K \
    STOPTASKS,/tmp,100M,100K \
    ABORT,${TMPDIR},100M,1K \
    ABORT,${DL_DIR},100M,1K \
    ABORT,${SSTATE_DIR},100M,1K \
    ABORT,/tmp,10M,1K"

CONF_VERSION = "2"

#IMAGE_FSTYPES = "wic.qcow2"

# Additional 500MB of disk space
#IMAGE_ROOTFS_EXTRA_SPACE = "1024000"

# For RAUC
MACHINE_FEATURES:append = " pcbios efi"
EXTRA_IMAGEDEPENDS += "ovmf"

# Settings for meta-rauc-qemux86
IMAGE_INSTALL:append = " rauc"
PREFERRED_RPROVIDER_virtual-grub-bootconf = "rauc-qemu-grubconf"

do_image_wic[depends] += "boot-image:do_deploy"

WKS_FILES = "qemux86-grub-efi.wks"

# Save disk space during build
INHERIT += "rm_work"

# Keep the following files
RM_WORK_EXCLUDE += " sdv-image-full"
RM_WORK_EXCLUDE += " sdv-image-minimal"
RM_WORK_EXCLUDE += " sdv-image-rescue"
RM_WORK_EXCLUDE += " sdv-image-all"
RM_WORK_EXCLUDE += " sdv-rauc-bundle"
```

## meta-leda-tegra/conf/layer.conf
```bitbake
# /********************************************************************************
# * Copyright (c) 2023 Contributors to the Eclipse Foundation
# *
# * See the NOTICE file(s) distributed with this work for additional
# * information regarding copyright ownership.
# *
# * This program and the accompanying materials are made available under the
# * terms of the Apache License 2.0 which is available at
# * https://www.apache.org/licenses/LICENSE-2.0
# *
# * SPDX-License-Identifier: Apache-2.0
# ********************************************************************************/
# We have a conf and classes directory, add to BBPATH
BBPATH .= ":${LAYERDIR}"

# We have recipes-* directories, add to BBFILES
BBFILES += "${LAYERDIR}/recipes-*/*/*.bb \
            ${LAYERDIR}/recipes-*/*/*.bbappend"

BBFILE_COLLECTIONS += "meta-leda-tegra"
BBFILE_PATTERN_meta-leda-tegra = "^${LAYERDIR}/"
BBFILE_PRIORITY_meta-leda-tegra = "6"

LAYERDEPENDS_meta-leda-tegra = " \
           core \
           meta-kanto \
           meta-rauc-tegra \
"
LAYERSERIES_COMPAT_meta-leda-tegra = "kirkstone"
```

## patch-rpi4/conf/layer.conf
```bitbake
# We have a conf and classes directory, append to BBPATH
BBPATH .= ":${LAYERDIR}"

# We have a recipes directory containing .bb and .bbappend files, add to BBFILES
BBFILES += "${LAYERDIR}/recipes*/*/*.bb \
            ${LAYERDIR}/recipes*/*/*.bbappend"

BBFILE_COLLECTIONS += "rpiconfig"
BBFILE_PATTERN_rpiconfig := "^${LAYERDIR}/"
BBFILE_PRIORITY_rpiconfig = "9"

LAYERSERIES_COMPAT_rpiconfig = "honister"
LAYERDEPENDS_rpiconfig = "core"
```

## patch/conf/layer.conf
```bitbake
# /********************************************************************************
# * Copyright (c) 2022 Contributors to the Eclipse Foundation
# *
# * See the NOTICE file(s) distributed with this work for additional
# * information regarding copyright ownership.
# *
# * This program and the accompanying materials are made available under the
# * terms of the Apache License 2.0 which is available at
# * https://www.apache.org/licenses/LICENSE-2.0
# *
# * SPDX-License-Identifier: Apache-2.0
# ********************************************************************************/

# We have a conf and classes directory, add to BBPATH
BBPATH .= ":${LAYERDIR}"

# We have recipes-* directories, add to BBFILES
BBFILES += "${LAYERDIR}/recipes-*/*/*.bb ${LAYERDIR}/recipes-*/*/*.bbappend"

BBFILE_COLLECTIONS += "patch"
BBFILE_PATTERN_patch = "^${LAYERDIR}/"
BBFILE_PRIORITY_patch = "6"

LAYERDEPENDS_patch = "core"
LAYERSERIES_COMPAT_patch = "honister"
```
